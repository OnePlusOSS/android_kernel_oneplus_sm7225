## drivers/oneplus/input/Kconfig
```kconfig
# oem device deriver
source "drivers/oneplus/input/touchscreen/Kconfig"
source "drivers/oneplus/input/fingerprint/Kconfig"

config TOUCHPANEL_ONEPLUS
	default n
	bool "Enable/Disable the touchscreen common driver"

config OP_HIMAX
       default n
       bool "Enable/Disable the touchscreen_himax driver"
```

## drivers/oneplus/input/fingerprint/Kconfig
```kconfig
menuconfig INPUT_FINGERPRINT
	bool "Fingerprint"
	default y
	help
	  Say Y here, and a list of supported fingerprint will be displayed.
	  This option doesn't affect the kernel.

	  If unsure, say Y.

if INPUT_FINGERPRINT

source "drivers/oneplus/input/fingerprint/egis520/Kconfig"
#a mecro(FINGERPRINT_ET520) defined in et520/Kconfig
source "drivers/oneplus/input/fingerprint/et520/Kconfig"


config FINGERPRINT_DETECT
	tristate "fingerprint detect support"
	depends on SPI_MASTER


config FINGERPRINT_GOODIX
	tristate "goodix fingerprint sensor support"
	depends on SPI_MASTER


config MSM_QBT1000
    bool "QBT1000 Ultrasonic Fingerprint Sensor"
    help
      This driver provides services for configuring the fingerprint
      sensor hardware and for communicating with the trusted app which
      uses it. It enables clocks and provides commands for loading
      trusted apps, unloading them and marshalling buffers to the
      trusted fingerprint app.
endif
```

## drivers/oneplus/input/fingerprint/et520/Kconfig
```kconfig
# SPDX-License-Identifier: GPL-2.0-only

config FINGERPRINT_ET520
	tristate "et520xx fingerprint sensor support"
	depends on SPI_MASTER
	help
	  support et520xx
	  This driver can also be built as a module.  If so, the module
	  will be called et523
```

## drivers/oneplus/input/touchscreen/Focal/Kconfig
```kconfig
#source "drivers/oneplus/input/touchscreen/Focal/FT8006/Kconfig"
source "drivers/oneplus/input/touchscreen/Focal/ft3518/Kconfig"
```

## drivers/oneplus/input/touchscreen/Kconfig
```kconfig
source "drivers/oneplus/input/touchscreen/Focal/Kconfig"
source "drivers/oneplus/input/touchscreen/util_interface/Kconfig"
source "drivers/oneplus/input/touchscreen/samsung/Kconfig"
source "drivers/oneplus/input/touchscreen/Goodix/Kconfig"

config TOUCHPANEL_ONEPLUS
	default n
	bool "Enable/Disable the touchscreen common driver"

config OP_TOUCHSCREEN
	default y
	bool "Enable/Disable the touchscreen common driver"
```

## drivers/oneplus/wt_sys/Kconfig
```kconfig
config PRESS_KEY_TRIGGER_PANIC
	bool "Enable press hot key trigger the crash"
	default n
	help
	  Press the power button, volume up button
	  and volume down button to trigger the crash.
```
